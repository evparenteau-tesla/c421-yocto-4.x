## meta-fsl-arm-extra/conf/machine/imx6soloc421.conf
```bitbake
#@TYPE: Machine
#@NAME: WinSystems i.MX6SOLO SBC-C421
#@SOC: i.MX6SOLO
#@DESCRIPTION: Machine configuration for WinSystems i.MX6SOLO SBC-C421
#@MAINTAINER: Paul DeMetrotion <pdemetrotion@winsystems.com>

require conf/machine/include/imx-base.inc
require conf/machine/include/tune-cortexa9.inc

SOC_FAMILY = "mx6:mx6dl:mx6q"

KERNEL_DEVICETREE = "imx6solo-c421.dtb"

PREFERRED_PROVIDER_u-boot = "u-boot-c421"
PREFERRED_VERSION_u-boot-c421 ?= "2015.04"
PREFERRED_PROVIDER_virtual/kernel ?= "linux-c421"
PREFERRED_VERSION_linux-c421 ?= "4.1.15"

#UBOOT_MACHINE = "mx6soloc421_config"

UBOOT_CONFIG ??= "spinor"
UBOOT_CONFIG[sd] = "mx6soloc421_config,sdcard"
UBOOT_CONFIG[spinor] = "mx6soloc421_spinor_config"
UBOOT_CONFIG[mfgtool] = "mx6soloc421_config"

SERIAL_CONSOLE = "115200 ttymxc0"

MACHINE_FEATURES += " ext2 keyboard serial usbgadget usbhost vfat"
```

## meta-fsl-arm-extra/recipes-bsp/u-boot/u-boot-c421/Kconfig
```kconfig
if TARGET_MX6SOLOC421

config SYS_BOARD
	default "mx6soloc421"

config SYS_VENDOR
	default "freescale"

config SYS_CONFIG_NAME
	default "mx6soloc421"

endif
```

## meta-fsl-arm-extra/recipes-bsp/u-boot/u-boot-c421/mx6soloc421_spinor_defconfig
```kconfig
CONFIG_ARM=y
CONFIG_ARCH_MX6=y
CONFIG_TARGET_MX6SOLOC421=y
CONFIG_SYS_EXTRA_OPTIONS="IMX_CONFIG=board/freescale/mx6soloc421/mx6solo.cfg,MX6DL,DDR_MB=1024,SYS_BOOT_SPINOR"
# CONFIG_CMD_IMLS is not set
# CONFIG_CMD_FLASH is not set
CONFIG_SPI_FLASH=y
CONFIG_SPI_FLASH_STMICRO=y
```
